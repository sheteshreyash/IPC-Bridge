/dts-v1/;
/plugin/;

&spi0 {
    #address-cells = <1>;
    #size-cells = <0>;
    status = "okay";

    telem0@0 {
        compatible = "ipc-bridge,telem0";
        reg = <0>;
        spi-max-frequency = <1000000>;
        ready-gpios = <&gpio 25 0>;
        status = "okay";
    };
};
