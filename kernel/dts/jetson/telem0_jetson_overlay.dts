/dts-v1/;
/plugin/;

/ {
    fragment@0 {
        target = <&spi0>;

        __overlay__ {
            #address-cells = <1>;
            #size-cells = <0>;

            status = "okay";

            telem0@0 {
                compatible = "ipc-bridge,telem0";
                reg = <0>;
                spi-max-frequency = <1000000>;
                ready-gpios = <&gpio 200 0>;
                status = "okay";
            };
        };
    };
};
